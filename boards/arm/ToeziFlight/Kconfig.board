## boards/arm/ToeziFlight/Kconfig.board
```kconfig
config BOARD_TOEZI_FLIGHT
   bool "ToeziFlight board"
   depends on SOC_STM32H723XX
```

## boards/arm/ToeziFlight/Kconfig.defconfig
```kconfig
if BOARD_TOEZI_FLIGHT

config BOARD
	default "toezi_flight"

endif # BOARD_TOEZI_FLIGHT
```
